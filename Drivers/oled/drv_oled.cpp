#include "drv_oled.hpp"
#include "hardware/drv_common.hpp"
#include "stm32h7xx_hal.h"
#include <cstdio>
#include <cstring>

// OLED 控制引脚定义
// CS接地，取未使用的PE10, RES = PE15 , DC = PE12
static const HwPin OLED_CS_PIN  = HW_PIN(4, 10, 0);
static const HwPin OLED_RES_PIN = HW_PIN(4, 15, 0);
static const HwPin OLED_DC_PIN  = HW_PIN(4, 12, 0);

// 单例指针 (供 u8g2 静态回调路由)
DrvOLED *DrvOLED::s_active = nullptr;

// =============================================================================
// 图标位图数据
// =============================================================================

const unsigned char Logo[] U8X8_PROGMEM = {
0x00,0x00,0x00,0x00,0x00,0x00,0x00,0x00,0x00,0x00,0x00,0x00,0x00,0x00,0x00,0x00,0x00,0x00,0x00,0x00,0x00,0x00,0x00,0x00,0x00,0x00,0x00,0x00,0x00,0x00,0x00,0x00,
0x00,0x00,0x00,0x00,0x00,0x00,0x00,0x00,0x00,0x00,0x00,0x00,0x00,0x00,0x00,0x00,0x00,0x00,0x00,0x00,0x00,0x00,0x00,0x00,0x00,0x00,0x00,0x00,0x00,0x00,0x00,0x00,
0x00,0x00,0x00,0x00,0x00,0x00,0x00,0x00,0x00,0x00,0x00,0x00,0x00,0x00,0x00,0x00,0x00,0x00,0x00,0x00,0x00,0x00,0x00,0x00,0x00,0x00,0x00,0x00,0x00,0x00,0x00,0x00,
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0x00,0x00,0x00,0x00,0x00,0x00,0x00,0x00,0x00,0x00,0x00,0x00,0x00,0x00,0x00,0x00,0x00,0x00,0x00,0x00,0x00,0x00,0x00,0x00,0x00,0x00,0x00,0x00,0x00,0x00,0x00,0x00,
};

// 宽16 高16
static const uint8_t NoSignal[] = {
    0x00,0x00,0x00,0x20,0xE0,0x17,0x10,0x08,0xC8,0x17,0x24,0x26,0x10,0x09,0xC0,0x03,0x40,0x00,0xA0,0x01,0x10,0x00,0x00,0x00,0x00,
    0x00,0x00,0x00,0x00,0x00,0x00,0x00
};

// 宽8 高16
static const uint8_t Bluetooth[] = {
    0x00,0x08,0x18,0x28,0x49,0x2A,0x1C,0x08,0x1C,0x2A,0x49,0x28,0x18,0x08,0x00,0x00
};

// 宽16 高8
static const uint8_t Lowbattery[] = {
    0x00,0x00,0xFC,0x1F,0x0C,0x10,0x0C,0x30,0x0C,0x30,0x0C,0x10,0xFC,0x1F,0x00,0x00
};
static const uint8_t Middlebattery[] = {
    0x00,0x00,0xFC,0x1F,0xFC,0x10,0xFC,0x30,0xFC,0x30,0xFC,0x10,0xFC,0x1F,0x00,0x00
};
static const uint8_t Highbattery[] = {
    0x00,0x00,0xFC,0x1F,0xFC,0x17,0xFC,0x37,0xFC,0x37,0xFC,0x17,0xFC,0x1F,0x00,0x00
};
static const uint8_t Fullbattery[] = {
    0x00,0x00,0xFC,0x1F,0xFC,0x1F,0xFC,0x3F,0xFC,0x3F,0xFC,0x1F,0xFC,0x1F,0x00,0x00
};

// 警告图标
static const uint8_t warn_icon[] = {
    0x30,0x00,0x48,0x00,0xB4,0x00,0xB4,0x00,0x32,0x01,0x32,0x01,0x32,0x01,0x01,0x02,
    0x31,0x02,0x01,0x02,0xFF,0x03
};

// =============================================================================
// 构造 / GPIO / 复位
// =============================================================================

DrvOLED::DrvOLED(BoardSpiPort port)
    : m_port(port), m_inited(false)
{
    s_active = this;
}

void DrvOLED::initGPIO()
{
    HW_ConfigurePinOutput(&OLED_CS_PIN,  HW_OTYPE_PUSH_PULL, GPIO_PULLUP,   GPIO_SPEED_FREQ_HIGH);
    HW_ConfigurePinOutput(&OLED_DC_PIN,  HW_OTYPE_PUSH_PULL, GPIO_NOPULL,   GPIO_SPEED_FREQ_HIGH);
    HW_ConfigurePinOutput(&OLED_RES_PIN, HW_OTYPE_PUSH_PULL, GPIO_NOPULL,   GPIO_SPEED_FREQ_HIGH);
    csHigh();
    dcHigh();
    rstHigh();
}

void DrvOLED::hardwareReset()
{
    rstLow();
    osDelay(100);
    rstHigh();
    osDelay(100);
}

// =============================================================================
// GPIO 引脚电平
// =============================================================================

void DrvOLED::csLow()  { HAL_GPIO_WritePin(HW_GpioTable[OLED_CS_PIN.port],  (uint16_t)(1u << OLED_CS_PIN.pin),  GPIO_PIN_RESET); }
void DrvOLED::csHigh() { HAL_GPIO_WritePin(HW_GpioTable[OLED_CS_PIN.port],  (uint16_t)(1u << OLED_CS_PIN.pin),  GPIO_PIN_SET); }
void DrvOLED::dcLow()  { HAL_GPIO_WritePin(HW_GpioTable[OLED_DC_PIN.port],  (uint16_t)(1u << OLED_DC_PIN.pin),  GPIO_PIN_RESET); }
void DrvOLED::dcHigh() { HAL_GPIO_WritePin(HW_GpioTable[OLED_DC_PIN.port],  (uint16_t)(1u << OLED_DC_PIN.pin),  GPIO_PIN_SET); }
void DrvOLED::rstLow() { HAL_GPIO_WritePin(HW_GpioTable[OLED_RES_PIN.port], (uint16_t)(1u << OLED_RES_PIN.pin), GPIO_PIN_RESET); }
void DrvOLED::rstHigh(){ HAL_GPIO_WritePin(HW_GpioTable[OLED_RES_PIN.port], (uint16_t)(1u << OLED_RES_PIN.pin), GPIO_PIN_SET); }

// =============================================================================
// SPI 发送 (走 board_spi_write)
// =============================================================================

void DrvOLED::spiSend(const uint8_t *data, uint16_t len)
{
    if (!data || len == 0)
        return;
    board_spi_write(m_port, data, len, -1.0);
}

// =============================================================================
// SSD1306 命令 / 数据
// =============================================================================

void DrvOLED::writeCMD(uint8_t cmd)
{
    dcLow();
    csLow();
    osDelay(1);
    spiSend(&cmd, 1);
    csHigh();
    osDelay(5);
}

void DrvOLED::writeData(uint8_t data)
{
    dcHigh();
    csLow();
    osDelay(1);
    spiSend(&data, 1);
    csHigh();
    osDelay(5);
}

void DrvOLED::writeDataBuffer(const uint8_t *data, uint8_t count)
{
    dcHigh();
    csLow();
    osDelay(1);
    spiSend(data, count);
    osDelay(1);
    csHigh();
}

void DrvOLED::initSSD1306()
{
    //SSD1306 初始化命令序列
    writeCMD(0xAE);    //关闭显示
    writeCMD(0x00);    //设置列低地址
    writeCMD(0x10);    //设置列高地址
    writeCMD(0x40);    //设置显示起始行
    writeCMD(0x81);    //设置对比度
    writeCMD(0xCF);
    writeCMD(0xA1);    //设置段映射
    writeCMD(0xC8);    //设置COM扫描方向
    writeCMD(0xA6);    //正常显示
    writeCMD(0xA8);    //设置多路复用
    writeCMD(0x3F);    //64行
    writeCMD(0xD3);    //设置显示偏移
    writeCMD(0x00);
    writeCMD(0xD5);    //设置时钟分频
    writeCMD(0x80);
    writeCMD(0xD9);    //设置预充电周期
    writeCMD(0xF1);
    writeCMD(0xDA);    //设置COM引脚硬件配置
    writeCMD(0x12);
    writeCMD(0xDB);    //设置VCOMH
    writeCMD(0x40);
    writeCMD(0x20);    //设置内存寻址模式
    writeCMD(0x02);    //页寻址模式
    writeCMD(0x8D);    //电荷泵
    writeCMD(0x14);    //使能电荷泵
    writeCMD(0xA4);    //恢复显示RAM输出
    writeCMD(0xA6);    //正常显示
    writeCMD(0xAF);    //开启显示
}

// =============================================================================
// u8g2 回调
// =============================================================================

uint8_t DrvOLED::u8x8ByteCb(u8x8_t *u8x8, uint8_t msg, uint8_t arg_int, void *arg_ptr)
{
    (void)u8x8;
    if (!s_active)
        return 0;

    switch (msg)
    {
        case U8X8_MSG_BYTE_SEND:
            //整块发送
            s_active->spiSend((const uint8_t *)arg_ptr, arg_int);
            break;

        case U8X8_MSG_BYTE_INIT:
            //SPI 已由 board 层初始化
            break;

        case U8X8_MSG_BYTE_SET_DC:
            if (arg_int) s_active->dcHigh();
            else         s_active->dcLow();
            break;

        case U8X8_MSG_BYTE_START_TRANSFER:
            s_active->csLow();
            if (u8x8->display_info->post_chip_enable_wait_ns > 0)
                u8x8->gpio_and_delay_cb(u8x8, U8X8_MSG_DELAY_NANO,
                                        u8x8->display_info->post_chip_enable_wait_ns, NULL);
            break;

        case U8X8_MSG_BYTE_END_TRANSFER:
            if (u8x8->display_info->pre_chip_disable_wait_ns > 0)
                u8x8->gpio_and_delay_cb(u8x8, U8X8_MSG_DELAY_NANO,
                                        u8x8->display_info->pre_chip_disable_wait_ns, NULL);
            s_active->csHigh();
            break;

        default:
            return 0;
    }
    return 1;
}

uint8_t DrvOLED::u8x8GpioDelayCb(u8x8_t *u8x8, uint8_t msg, uint8_t arg_int, void *arg_ptr)
{
    (void)u8x8;
    (void)arg_ptr;
    if (!s_active)
        return 0;

    switch (msg)
    {
        case U8X8_MSG_GPIO_AND_DELAY_INIT:
            break;

        case U8X8_MSG_DELAY_MILLI:
            osDelay(arg_int);
            break;

        case U8X8_MSG_GPIO_CS:
            if (arg_int) s_active->csHigh();
            else         s_active->csLow();
            break;

        case U8X8_MSG_GPIO_DC:
            if (arg_int) s_active->dcHigh();
            else         s_active->dcLow();
            break;

        case U8X8_MSG_GPIO_RESET:
            if (arg_int) s_active->rstHigh();
            else         s_active->rstLow();
            break;

        default:
            return 0;
    }
    return 1;
}

// =============================================================================
// 初始化
// =============================================================================

bool DrvOLED::init()
{
    if (m_inited)
        return true;

    if (m_port == BOARD_SPI_NONE)
        return false;

    s_active = this;

    initGPIO();
    hardwareReset();

    //u8g2 建屏 (SSD1306 128x64 全缓冲, SPI 接口)
    u8g2_Setup_ssd1315_128x64_noname_f(&m_u8g2, U8G2_R0, u8x8ByteCb, u8x8GpioDelayCb);
    u8g2_InitDisplay(&m_u8g2);          //u8g2 内部发送 SSD1306 初始化命令
    u8g2_SetPowerSave(&m_u8g2, 0);      //开启显示
    u8g2_SetDisplayRotation(&m_u8g2, U8G2_R0);
    u8g2_ClearBuffer(&m_u8g2);

    m_inited = true;
    return true;
}

// =============================================================================
// 调试:
// =============================================================================
//
// 使用方法 (在 task_Display 任务入口处调用, 替代 u8g2 流程):
//
//   auto *oled = drv_oled();
//   oled->debugTest(1);   //第1步: 翻转 GPIO, 用万用表/示波器确认 CS/DC/RES 电平
//   oled->debugTest(2);   //第2步: 原始命令全屏点亮
//
// 决策树:
//   第1步 GPIO 电压不对 (无翻转)  → GPIO 配置问题 (引脚冲突/时钟未使能)
//   第1步对, 第2步屏幕仍全黑       → SPI 数据没发出 (驱动层/硬件接线/SCK极性)
//   第2步屏幕全亮                  → 硬件 OK, 问题在 u8g2 中间件集成
//
void DrvOLED::debugTest(uint8_t step)
{
    if (m_port == BOARD_SPI_NONE)
        return;

    s_active = this;
    initGPIO();   //确保 GPIO 已配置 (可重复调用)

    //------------- 第1步: GPIO 翻转测试 (万用表验证) -------------
    if (step == 1)
    {
        //RES: 拉低 2 秒(屏幕会复位变黑), 再拉高
        rstLow();  osDelay(2000);
        rstHigh(); osDelay(2000);
        //DC 翻转
        dcLow();   osDelay(1000);
        dcHigh();  osDelay(1000);
        //CS 翻转
        csLow();   osDelay(1000);
        csHigh();  osDelay(1000);
        return;
    }

    //------------- 第2步: 原始 SSD1306 命令, 全屏点亮 -------------
    if (step == 2)
    {
        //硬件复位
        rstLow();  osDelay(50);
        rstHigh(); osDelay(100);

        //最简初始化序列 (不依赖 u8g2)
        writeCMD(0xAE);              //display off
        writeCMD(0x20); writeCMD(0x00); //horizontal addressing mode
        writeCMD(0x21); writeCMD(0x00); writeCMD(0x7F); //col 0~127
        writeCMD(0x22); writeCMD(0x00); writeCMD(0x07); //page 0~7
        writeCMD(0x8D); writeCMD(0x14); //charge pump on
        writeCMD(0xAF);              //display on

        //连续写 128*8 = 1024 字节 0xFF, 点亮全部像素
        //(若屏幕亮起白屏 → SPI/GPIO/复位 全部正常, 问题在 u8g2 集成)
        csLow();
        dcHigh();   //数据模式
        static uint8_t fill[16];
        memset(fill, 0xFF, sizeof(fill));
        for (int i = 0; i < 64; i++)   //64 * 16 = 1024
            spiSend(fill, 16);
        csHigh();
        return;
    }
}

// =============================================================================
// u8g2 绘图接口
// =============================================================================

void DrvOLED::clear()       { u8g2_ClearBuffer(&m_u8g2); }
void DrvOLED::update()      { u8g2_SendBuffer(&m_u8g2); }

void DrvOLED::showString(uint8_t x, uint8_t y, const char *str)
{
    u8g2_SetFont(&m_u8g2, u8g2_font_ncenB10_tr);
    u8g2_DrawStr(&m_u8g2, x, y + 16, str);
}

void DrvOLED::showImage(uint8_t x, uint8_t y, uint8_t width, uint8_t height, const uint8_t *image)
{
    u8g2_DrawXBMP(&m_u8g2, x, y, width, height, image);
}

void DrvOLED::drawPixel(uint8_t x, uint8_t y)
{
    u8g2_DrawPixel(&m_u8g2, x, y);
}

void DrvOLED::drawLine(int16_t x0, int16_t y0, int16_t x1, int16_t y1)
{
    u8g2_DrawLine(&m_u8g2, x0, y0, x1, y1);
}

void DrvOLED::drawCircle(int16_t x, int16_t y, uint8_t radius, uint8_t is_filled)
{
    if (is_filled)
        u8g2_DrawDisc(&m_u8g2, x, y, radius, U8G2_DRAW_ALL);
    else
        u8g2_DrawCircle(&m_u8g2, x, y, radius, U8G2_DRAW_ALL);
}

void DrvOLED::drawRectangle(int16_t x, int16_t y, uint8_t width, uint8_t height, uint8_t is_filled)
{
    if (is_filled)
        u8g2_DrawBox(&m_u8g2, x, y, width, height);
    else
        u8g2_DrawFrame(&m_u8g2, x, y, width, height);
}

void DrvOLED::showChinese(int16_t x, int16_t y, const char *chinese)
{
    u8g2_SetFont(&m_u8g2, u8g2_font_wqy12_t_gb2312b);
    u8g2_DrawUTF8(&m_u8g2, x + 2, y + 12, chinese);
}

void DrvOLED::showFloat(uint8_t x, uint8_t y, float num)
{
    char buf[20];
    int32_t temp = (int32_t)(num * 10000);
    int32_t int_part = temp / 10000;
    int32_t frac_part = temp % 10000;
    if (frac_part < 0) frac_part = -frac_part;
    sprintf(buf, "%ld.%04ld", (long)int_part, (long)frac_part);
    showString(x, y, buf);
}

// =============================================================================
// 预置图标
// =============================================================================

void DrvOLED::displayLogo()  { showImage(0, 0, 128, 64, Logo); }
void DrvOLED::showBLEON()    { showImage(94, 0, 8, 16, Bluetooth); }
void DrvOLED::showBLEOFF()   { showImage(94, 0, 16, 16, NoSignal); }
void DrvOLED::lowBattery()   { showImage(110, 0, 16, 8, Lowbattery); }
void DrvOLED::middleBattery(){ showImage(110, 0, 16, 8, Middlebattery); }
void DrvOLED::highBattery()  { showImage(110, 0, 16, 8, Highbattery); }
void DrvOLED::fullBattery()  { showImage(110, 0, 16, 8, Fullbattery); }
void DrvOLED::warn()         { showImage(58, 0, 11, 11, warn_icon); }

// =============================================================================
// 全局访问函数
// =============================================================================

static DrvOLED *g_drv_oled = nullptr;

void init_drv_oled()
{
    if (g_drv_oled)
        return;

    g_drv_oled = new DrvOLED(BOARD_SPI_OLED);
    if (g_drv_oled)
        g_drv_oled->init();
}

DrvOLED *drv_oled()
{
    return g_drv_oled;
}
